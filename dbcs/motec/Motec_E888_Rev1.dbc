VERSION ""

NS_ :

BS_:

BU_: E8xx_Expander

BO_ 240 Inputs: 8 E8xx_Expander
 SG_ Index0F0 M: 7|3 @0+ (1,0) [0|8] "unitless:" Vector__XXX
 SG_ AV1 m0: 4|13 @0+ (0.001,0) [0|8.191] "voltage:V" Vector__XXX
 SG_ AV2 m0: 23|16 @0- (0.001,0) [-32.768|32.767] "voltage:V" Vector__XXX
 SG_ TC1 m0: 39|16 @0- (0.25,0) [-8192|8191.75] "temperature:C" Vector__XXX
 SG_ TC2 m0: 55|16 @0- (0.25,0) [-8192|8191.75] "temperature:C" Vector__XXX
 SG_ AV3 m1: 4|13 @0+ (0.001,0) [0|8.191] "voltage:V" Vector__XXX
 SG_ AV4 m1: 23|16 @0- (0.001,0) [-32.768|32.767] "voltage:V" Vector__XXX
 SG_ TC3 m1: 39|16 @0- (0.25,0) [-8192|8191.75] "temperature:C" Vector__XXX
 SG_ TC4 m1: 55|16 @0- (0.25,0) [-8192|8191.75] "temperature:C" Vector__XXX
 SG_ AV5 m2: 4|13 @0+ (0.001,0) [0|8.191] "voltage:V" Vector__XXX
 SG_ AV6 m2: 23|16 @0- (0.001,0) [-32.768|32.767] "voltage:V" Vector__XXX
 SG_ TC5 m2: 39|16 @0- (0.25,0) [-8192|8191.75] "temperature:C" Vector__XXX
 SG_ TC6 m2: 55|16 @0- (0.25,0) [-8192|8191.75] "temperature:C" Vector__XXX
 SG_ AV7 m3: 4|13 @0+ (0.001,0) [0|8.191] "voltage:V" Vector__XXX
 SG_ TC7 m3: 23|16 @0- (0.25,0) [-8192|8191.75] "temperature:C" Vector__XXX
 SG_ Freq1 m3: 39|16 @0- (0.1,0) [-3276.8|3276.7] "frequency:Hz" Vector__XXX
 SG_ Freq2 m3: 55|16 @0- (0.1,0) [-3276.8|3276.7] "frequency:Hz" Vector__XXX
 SG_ AV8 m4: 4|13 @0+ (0.001,0) [0|8.191] "voltage:V" Vector__XXX
 SG_ TC8 m4: 23|16 @0- (0.25,0) [-8192|8191.75] "temperature:C" Vector__XXX
 SG_ Freq3 m4: 39|16 @0- (0.1,0) [-3276.8|3276.7] "frequency:Hz" Vector__XXX
 SG_ Freq4 m4: 55|16 @0- (0.1,0) [-3276.8|3276.7] "frequency:Hz" Vector__XXX

BO_ 241 Diagnostics: 8 E8xx_Expander
 SG_ Index0F1 M: 7|4 @0+ (1,0) [0|15] "unitless:" Vector__XXX
 SG_ Cold_Junct_Comp1 m0: 3|12 @0+ (1,-200) [-200|3895] "temperature:C" Vector__XXX
 SG_ Cold_Junct_Comp2 m0: 23|16 @0+ (1,-200) [-200|65335] "temperature:C" Vector__XXX
 SG_ E888_Int_Temp m0: 39|16 @0+ (1,-200) [0|65335] "temperature:C" Vector__XXX
 SG_ Dig_6_In_State m0: 53|1 @0+ (1,0) [0|1] "unitless:" Vector__XXX
 SG_ Dig_5_In_State m0: 52|1 @0+ (1,0) [0|1] "unitless:" Vector__XXX
 SG_ Dig_4_In_State m0: 51|1 @0+ (1,0) [0|1] "unitless:" Vector__XXX
 SG_ Dig_3_In_State m0: 50|1 @0+ (1,0) [0|1] "unitless:" Vector__XXX
 SG_ Dig_2_In_State m0: 49|1 @0+ (1,0) [0|1] "unitless:" Vector__XXX
 SG_ Dig_1_In_State m0: 48|1 @0+ (1,0) [0|1] "unitless:" Vector__XXX
 SG_ Battery_Volts m1: 55|16 @0- (0.01,0) [-327.68|327.67] "voltage:V" Vector__XXX
 SG_ E888_Status_Flags m2: 23|16 @0+ (1,0) [0|65535] "unitless:" Vector__XXX
 SG_ Firmware_Version m2: 39|16 @0+ (0.01,0) [0|655.35] "unitless:" Vector__XXX

 CM_ BO_ 240 "Inputs";
CM_ SG_ 240 Freq1 "0-3200 Hz";
CM_ SG_ 240 Freq2 "0-3200 Hz";
CM_ SG_ 240 Freq3 "0-3200 Hz";
CM_ SG_ 240 Freq4 "0-3200 Hz";
CM_ BO_ 241 "Diagnostics";
CM_ SG_ 241 Dig_6_In_State "Shows the current state of the digital input";
CM_ SG_ 241 Dig_5_In_State "Shows the current state of the digital input";
CM_ SG_ 241 Dig_4_In_State "Shows the current state of the digital input";
CM_ SG_ 241 Dig_3_In_State "Shows the current state of the digital input";
CM_ SG_ 241 Dig_2_In_State "Shows the current state of the digital input";
CM_ SG_ 241 Dig_1_In_State "Shows the current state of the digital input";

BA_DEF_ BO_  "DBC_Author" STRING ;
BA_DEF_ BO_  "GenMsgSendType" STRING ;
BA_DEF_ BO_  "GenMsgCycleTime" INT 1 10000;
BA_DEF_ BO_  "GenMsgILSupport" ENUM  "No","Yes";
BA_DEF_ BU_  "ILUsed" ENUM  "No","Yes";
BA_DEF_  "VersionNumber" INT 0 10000;
BA_DEF_  "VersionDay" INT 1 31;
BA_DEF_  "VersionMonth" INT 1 12;
BA_DEF_  "VersionYear" INT 2016 3000;
BA_DEF_  "BusType" STRING ;
BA_DEF_ BO_  "DBC_Author_Contact" STRING ;
BA_DEF_DEF_  "DBC_Author_Contact" "CANbusInfo@AEMelectronics.com";
BA_DEF_DEF_  "DBC_Author" "AEM_Performance_Electronics";
BA_DEF_DEF_  "GenMsgSendType" "Cyclic";
BA_DEF_DEF_  "GenMsgCycleTime" 5;
BA_DEF_DEF_  "GenMsgILSupport" "Yes";
BA_DEF_DEF_  "ILUsed" "Yes";
BA_DEF_DEF_  "VersionNumber" 0;
BA_DEF_DEF_  "VersionDay" 15;
BA_DEF_DEF_  "VersionMonth" 12;
BA_DEF_DEF_  "VersionYear" 2016;
BA_DEF_DEF_  "BusType" "Can";
BA_ "BusType" "CAN";
