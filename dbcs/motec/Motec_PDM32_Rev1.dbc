VERSION ""

NS_ :

BS_:

BU_: PDM32

BO_ 1280 InputStates: 8 PDM32
 SG_ PDM_Index_0x500 M : 7|4@0+ (1,0) [0|15] "unitless:" Vector__XXX
 SG_ PDM_InputState1 m0 : 0|1@0+ (1,0) [0|1] "unitless:" Vector__XXX
 SG_ PDM_InputState2 m0 : 8|1@0+ (1,0) [0|1] "unitless:" Vector__XXX
 SG_ PDM_InputState3 m0 : 16|1@0+ (1,0) [0|1] "unitless:" Vector__XXX
 SG_ PDM_InputState4 m0 : 24|1@0+ (1,0) [0|1] "unitless:" Vector__XXX
 SG_ PDM_InputState5 m0 : 32|1@0+ (1,0) [0|1] "unitless:" Vector__XXX
 SG_ PDM_InputState6 m0 : 40|1@0+ (1,0) [0|1] "unitless:" Vector__XXX
 SG_ PDM_InputState7 m0 : 48|1@0+ (1,0) [0|1] "unitless:" Vector__XXX
 SG_ PDM_InputState8 m0 : 56|1@0+ (1,0) [0|1] "unitless:" Vector__XXX
 SG_ PDM_InputState9 m1 : 0|1@0+ (1,0) [0|1] "unitless:" Vector__XXX
 SG_ PDM_InputState10 m1 : 8|1@0+ (1,0) [0|1] "unitless:" Vector__XXX
 SG_ PDM_InputState11 m1 : 16|1@0+ (1,0) [0|1] "unitless:" Vector__XXX
 SG_ PDM_InputState12 m1 : 24|1@0+ (1,0) [0|1] "unitless:" Vector__XXX
 SG_ PDM_InputState13 m1 : 32|1@0+ (1,0) [0|1] "unitless:" Vector__XXX
 SG_ PDM_InputState14 m1 : 40|1@0+ (1,0) [0|1] "unitless:" Vector__XXX
 SG_ PDM_InputState15 m1 : 48|1@0+ (1,0) [0|1] "unitless:" Vector__XXX
 SG_ PDM_InputState16 m1 : 56|1@0+ (1,0) [0|1] "unitless:" Vector__XXX
 SG_ PDM_InputState17 m2 : 0|1@0+ (1,0) [0|1] "unitless:" Vector__XXX
 SG_ PDM_InputState18 m2 : 8|1@0+ (1,0) [0|1] "unitless:" Vector__XXX
 SG_ PDM_InputState19 m2 : 16|1@0+ (1,0) [0|1] "unitless:" Vector__XXX
 SG_ PDM_InputState20 m2 : 24|1@0+ (1,0) [0|1] "unitless:" Vector__XXX
 SG_ PDM_InputState21 m2 : 32|1@0+ (1,0) [0|1] "unitless:" Vector__XXX
 SG_ PDM_InputState22 m2 : 40|1@0+ (1,0) [0|1] "unitless:" Vector__XXX
 SG_ PDM_InputState23 m2 : 48|1@0+ (1,0) [0|1] "unitless:" Vector__XXX
 SG_ PDM_InternalTemp m3 : 15|8@0+ (1,0) [0|255] "temperature:C" Vector__XXX
 SG_ PDM_Battery_Voltage m3 : 23|8@0+ (0.1216,0) [0|31.008] "voltage:V" Vector__XXX
 SG_ PDM_GlobalErrorFlag m3 : 31|8@0+ (1,0) [0|255] "" Vector__XXX
 SG_ PDM_TotalCurrent m3 : 39|8@0+ (1,0) [0|255] "current:A" Vector__XXX
 SG_ PDM_9_5v_IntRailVoltage m3 : 47|8@0+ (0.0615,0) [0|15.6825] "voltage:V" Vector__XXX
 SG_ PDM_ResetSource m3 : 55|8@0+ (1,0) [0|255] "" Vector__XXX

BO_ 1281 OutputCurrent: 8 PDM32
 SG_ PDM_Index_0x501 M : 7|8@0+ (1,0) [0|255] "unitless:" Vector__XXX
 SG_ PDM_OutputCurrent1 m0 : 15|8@0+ (0.5,0) [0|127.5] "current:A" Vector__XXX
 SG_ PDM_OutputCurrent2 m0 : 23|8@0+ (0.5,0) [0|127.5] "current:A" Vector__XXX
 SG_ PDM_OutputCurrent3 m0 : 31|8@0+ (0.5,0) [0|127.5] "current:A" Vector__XXX
 SG_ PDM_OutputCurrent4 m0 : 39|8@0+ (0.5,0) [0|127.5] "current:A" Vector__XXX
 SG_ PDM_OutputCurrent5 m0 : 47|8@0+ (0.5,0) [0|127.5] "current:A" Vector__XXX
 SG_ PDM_OutputCurrent6 m0 : 55|8@0+ (0.5,0) [0|127.5] "current:A" Vector__XXX
 SG_ PDM_OutputCurrent7 m0 : 63|8@0+ (0.5,0) [0|127.5] "current:A" Vector__XXX
 SG_ PDM_OutputCurrent8 m1 : 15|8@0+ (0.5,0) [0|127.5] "current:A" Vector__XXX
 SG_ PDM_OutputCurrent9 m1 : 23|8@0+ (0.2,0) [0|51] "current:A" Vector__XXX
 SG_ PDM_OutputCurrent10 m1 : 31|8@0+ (0.2,0) [0|51] "current:A" Vector__XXX
 SG_ PDM_OutputCurrent11 m1 : 39|8@0+ (0.2,0) [0|51] "current:A" Vector__XXX
 SG_ PDM_OutputCurrent12 m1 : 47|8@0+ (0.2,0) [0|51] "current:A" Vector__XXX
 SG_ PDM_OutputCurrent13 m1 : 55|8@0+ (0.2,0) [0|51] "current:A" Vector__XXX
 SG_ PDM_OutputCurrent14 m1 : 63|8@0+ (0.2,0) [0|51] "current:A" Vector__XXX
 SG_ PDM_OutputCurrent15 m2 : 15|8@0+ (0.2,0) [0|51] "current:A" Vector__XXX
 SG_ PDM_OutputCurrent16 m2 : 23|8@0+ (0.2,0) [0|51] "current:A" Vector__XXX
 SG_ PDM_OutputCurrent17 m2 : 31|8@0+ (0.2,0) [0|51] "current:A" Vector__XXX
 SG_ PDM_OutputCurrent18 m2 : 39|8@0+ (0.2,0) [0|51] "current:A" Vector__XXX
 SG_ PDM_OutputCurrent19 m2 : 47|8@0+ (0.2,0) [0|51] "current:A" Vector__XXX
 SG_ PDM_OutputCurrent20 m2 : 55|8@0+ (0.2,0) [0|51] "current:A" Vector__XXX
 SG_ PDM_OutputCurrent21 m2 : 63|8@0+ (0.2,0) [0|51] "current:A" Vector__XXX
 SG_ PDM_OutputCurrent22 m3 : 15|8@0+ (0.2,0) [0|51] "current:A" Vector__XXX
 SG_ PDM_OutputCurrent23 m3 : 23|8@0+ (0.2,0) [0|51] "current:A" Vector__XXX
 SG_ PDM_OutputCurrent24 m3 : 31|8@0+ (0.2,0) [0|51] "current:A" Vector__XXX
 SG_ PDM_OutputCurrent25 m3 : 39|8@0+ (0.2,0) [0|51] "current:A" Vector__XXX
 SG_ PDM_OutputCurrent26 m3 : 47|8@0+ (0.2,0) [0|51] "current:A" Vector__XXX
 SG_ PDM_OutputCurrent27 m3 : 55|8@0+ (0.2,0) [0|51] "current:A" Vector__XXX
 SG_ PDM_OutputCurrent28 m3 : 63|8@0+ (0.2,0) [0|51] "current:A" Vector__XXX
 SG_ PDM_OutputCurrent29 m4 : 15|8@0+ (0.2,0) [0|51] "current:A" Vector__XXX
 SG_ PDM_OutputCurrent30 m4 : 23|8@0+ (0.2,0) [0|51] "current:A" Vector__XXX
 SG_ PDM_OutputCurrent31 m4 : 31|8@0+ (0.2,0) [0|51] "current:A" Vector__XXX
 SG_ PDM_OutputCurrent32 m4 : 39|8@0+ (0.2,0) [0|51] "current:A" Vector__XXX

BO_ 1282 OutputLoad: 8 PDM32
 SG_ PDM_Index_0x502 M : 7|8@0+ (1,0) [0|255] "unitless:" Vector__XXX
 SG_ PDM_OutputLoad1 m0 : 15|8@0+ (1,0) [0|255] "fraction:%" Vector__XXX
 SG_ PDM_OutputLoad2 m0 : 23|8@0+ (1,0) [0|255] "fraction:%" Vector__XXX
 SG_ PDM_OutputLoad3 m0 : 31|8@0+ (1,0) [0|255] "fraction:%" Vector__XXX
 SG_ PDM_OutputLoad4 m0 : 39|8@0+ (1,0) [0|255] "fraction:%" Vector__XXX
 SG_ PDM_OutputLoad5 m0 : 47|8@0+ (1,0) [0|255] "fraction:%" Vector__XXX
 SG_ PDM_OutputLoad6 m0 : 55|8@0+ (1,0) [0|255] "fraction:%" Vector__XXX
 SG_ PDM_OutputLoad7 m0 : 63|8@0+ (1,0) [0|255] "fraction:%" Vector__XXX
 SG_ PDM_OutputLoad8 m1 : 15|8@0+ (1,0) [0|255] "fraction:%" Vector__XXX
 SG_ PDM_OutputLoad9 m1 : 23|8@0+ (1,0) [0|255] "fraction:%" Vector__XXX
 SG_ PDM_OutputLoad10 m1 : 31|8@0+ (1,0) [0|255] "fraction:%" Vector__XXX
 SG_ PDM_OutputLoad11 m1 : 39|8@0+ (1,0) [0|255] "fraction:%" Vector__XXX
 SG_ PDM_OutputLoad12 m1 : 47|8@0+ (1,0) [0|255] "fraction:%" Vector__XXX
 SG_ PDM_OutputLoad13 m1 : 55|8@0+ (1,0) [0|255] "fraction:%" Vector__XXX
 SG_ PDM_OutputLoad14 m1 : 63|8@0+ (1,0) [0|255] "fraction:%" Vector__XXX
 SG_ PDM_OutputLoad15 m2 : 15|8@0+ (1,0) [0|255] "fraction:%" Vector__XXX
 SG_ PDM_OutputLoad16 m2 : 23|8@0+ (1,0) [0|255] "fraction:%" Vector__XXX
 SG_ PDM_OutputLoad17 m2 : 31|8@0+ (1,0) [0|255] "fraction:%" Vector__XXX
 SG_ PDM_OutputLoad18 m2 : 39|8@0+ (1,0) [0|255] "fraction:%" Vector__XXX
 SG_ PDM_OutputLoad19 m2 : 47|8@0+ (1,0) [0|255] "fraction:%" Vector__XXX
 SG_ PDM_OutputLoad20 m2 : 55|8@0+ (1,0) [0|255] "fraction:%" Vector__XXX
 SG_ PDM_OutputLoad21 m2 : 63|8@0+ (1,0) [0|255] "fraction:%" Vector__XXX
 SG_ PDM_OutputLoad22 m3 : 15|8@0+ (1,0) [0|255] "fraction:%" Vector__XXX
 SG_ PDM_OutputLoad23 m3 : 23|8@0+ (1,0) [0|255] "fraction:%" Vector__XXX
 SG_ PDM_OutputLoad24 m3 : 31|8@0+ (1,0) [0|255] "fraction:%" Vector__XXX
 SG_ PDM_OutputLoad25 m3 : 39|8@0+ (1,0) [0|255] "fraction:%" Vector__XXX
 SG_ PDM_OutputLoad26 m3 : 47|8@0+ (1,0) [0|255] "fraction:%" Vector__XXX
 SG_ PDM_OutputLoad27 m3 : 55|8@0+ (1,0) [0|255] "fraction:%" Vector__XXX
 SG_ PDM_OutputLoad28 m3 : 63|8@0+ (1,0) [0|255] "fraction:%" Vector__XXX
 SG_ PDM_OutputLoad29 m4 : 15|8@0+ (1,0) [0|255] "fraction:%" Vector__XXX
 SG_ PDM_OutputLoad30 m4 : 23|8@0+ (1,0) [0|255] "fraction:%" Vector__XXX
 SG_ PDM_OutputLoad31 m4 : 31|8@0+ (1,0) [0|255] "fraction:%" Vector__XXX
 SG_ PDM_OutputLoad32 m4 : 39|8@0+ (1,0) [0|255] "fraction:%" Vector__XXX

BO_ 1283 OutputVoltages: 8 PDM32
 SG_ PDM_Index_0x503 M : 7|8@0+ (1,0) [0|255] "unitless:" Vector__XXX
 SG_ PDM_OutputVoltage1 m0 : 15|8@0+ (0.2,0) [0|51] "voltage:V" Vector__XXX
 SG_ PDM_OutputVoltage2 m0 : 23|8@0+ (0.2,0) [0|51] "voltage:V" Vector__XXX
 SG_ PDM_OutputVoltage3 m0 : 31|8@0+ (0.2,0) [0|51] "voltage:V" Vector__XXX
 SG_ PDM_OutputVoltage4 m0 : 39|8@0+ (0.2,0) [0|51] "voltage:V" Vector__XXX
 SG_ PDM_OutputVoltage5 m0 : 47|8@0+ (0.2,0) [0|51] "voltage:V" Vector__XXX
 SG_ PDM_OutputVoltage6 m0 : 55|8@0+ (0.2,0) [0|51] "voltage:V" Vector__XXX
 SG_ PDM_OutputVoltage7 m0 : 63|8@0+ (0.2,0) [0|51] "voltage:V" Vector__XXX
 SG_ PDM_OutputVoltage8 m1 : 15|8@0+ (0.2,0) [0|51] "voltage:V" Vector__XXX
 SG_ PDM_OutputVoltage9 m1 : 23|8@0+ (0.2,0) [0|51] "voltage:V" Vector__XXX
 SG_ PDM_OutputVoltage10 m1 : 31|8@0+ (0.2,0) [0|51] "voltage:V" Vector__XXX
 SG_ PDM_OutputVoltage11 m1 : 39|8@0+ (0.2,0) [0|51] "voltage:V" Vector__XXX
 SG_ PDM_OutputVoltage12 m1 : 47|8@0+ (0.2,0) [0|51] "voltage:V" Vector__XXX
 SG_ PDM_OutputVoltage13 m1 : 55|8@0+ (0.2,0) [0|51] "voltage:V" Vector__XXX
 SG_ PDM_OutputVoltage14 m1 : 63|8@0+ (0.2,0) [0|51] "voltage:V" Vector__XXX
 SG_ PDM_OutputVoltage15 m2 : 15|8@0+ (0.2,0) [0|51] "voltage:V" Vector__XXX
 SG_ PDM_OutputVoltage16 m2 : 23|8@0+ (0.2,0) [0|51] "voltage:V" Vector__XXX
 SG_ PDM_OutputVoltage17 m2 : 31|8@0+ (0.2,0) [0|51] "voltage:V" Vector__XXX
 SG_ PDM_OutputVoltage18 m2 : 39|8@0+ (0.2,0) [0|51] "voltage:V" Vector__XXX
 SG_ PDM_OutputVoltage19 m2 : 47|8@0+ (0.2,0) [0|51] "voltage:V" Vector__XXX
 SG_ PDM_OutputVoltage20 m2 : 55|8@0+ (0.2,0) [0|51] "voltage:V" Vector__XXX
 SG_ PDM_OutputVoltage21 m2 : 63|8@0+ (0.2,0) [0|51] "voltage:V" Vector__XXX
 SG_ PDM_OutputVoltage22 m3 : 15|8@0+ (0.2,0) [0|51] "voltage:V" Vector__XXX
 SG_ PDM_OutputVoltage23 m3 : 23|8@0+ (0.2,0) [0|51] "voltage:V" Vector__XXX
 SG_ PDM_OutputVoltage24 m3 : 31|8@0+ (0.2,0) [0|51] "voltage:V" Vector__XXX
 SG_ PDM_OutputVoltage25 m3 : 39|8@0+ (0.2,0) [0|51] "voltage:V" Vector__XXX
 SG_ PDM_OutputVoltage26 m3 : 47|8@0+ (0.2,0) [0|51] "voltage:V" Vector__XXX
 SG_ PDM_OutputVoltage27 m3 : 55|8@0+ (0.2,0) [0|51] "voltage:V" Vector__XXX
 SG_ PDM_OutputVoltage28 m3 : 63|8@0+ (0.2,0) [0|51] "voltage:V" Vector__XXX
 SG_ PDM_OutputVoltage29 m4 : 15|8@0+ (0.2,0) [0|51] "voltage:V" Vector__XXX
 SG_ PDM_OutputVoltage30 m4 : 23|8@0+ (0.2,0) [0|51] "voltage:V" Vector__XXX
 SG_ PDM_OutputVoltage31 m4 : 31|8@0+ (0.2,0) [0|51] "voltage:V" Vector__XXX
 SG_ PDM_OutputVoltage32 m4 : 39|8@0+ (0.2,0) [0|51] "voltage:V" Vector__XXX

BO_ 1284 OutputStatus: 8 PDM32
 SG_ PDM_Index_0x504 M : 7|8@0+ (1,0) [0|255] "unitless:" Vector__XXX
 SG_ PDM_OutputStatus1 m0 : 15|8@0+ (1,0) [0|255] "unitless:" Vector__XXX
 SG_ PDM_OutputStatus2 m0 : 23|8@0+ (1,0) [0|255] "unitless:" Vector__XXX
 SG_ PDM_OutputStatus3 m0 : 31|8@0+ (1,0) [0|255] "unitless:" Vector__XXX
 SG_ PDM_OutputStatus4 m0 : 39|8@0+ (1,0) [0|255] "unitless:" Vector__XXX
 SG_ PDM_OutputStatus5 m0 : 47|8@0+ (1,0) [0|255] "unitless:" Vector__XXX
 SG_ PDM_OutputStatus6 m0 : 55|8@0+ (1,0) [0|255] "unitless:" Vector__XXX
 SG_ PDM_OutputStatus7 m0 : 63|8@0+ (1,0) [0|255] "unitless:" Vector__XXX
 SG_ PDM_OutputStatus8 m1 : 15|8@0+ (1,0) [0|255] "unitless:" Vector__XXX
 SG_ PDM_OutputStatus9 m1 : 23|8@0+ (1,0) [0|255] "unitless:" Vector__XXX
 SG_ PDM_OutputStatus10 m1 : 31|8@0+ (1,0) [0|255] "unitless:" Vector__XXX
 SG_ PDM_OutputStatus11 m1 : 39|8@0+ (1,0) [0|255] "unitless:" Vector__XXX
 SG_ PDM_OutputStatus12 m1 : 47|8@0+ (1,0) [0|255] "unitless:" Vector__XXX
 SG_ PDM_OutputStatus13 m1 : 55|8@0+ (1,0) [0|255] "unitless:" Vector__XXX
 SG_ PDM_OutputStatus14 m1 : 63|8@0+ (1,0) [0|255] "unitless:" Vector__XXX
 SG_ PDM_OutputStatus15 m2 : 15|8@0+ (1,0) [0|255] "unitless:" Vector__XXX
 SG_ PDM_OutputStatus16 m2 : 23|8@0+ (1,0) [0|255] "unitless:" Vector__XXX
 SG_ PDM_OutputStatus17 m2 : 31|8@0+ (1,0) [0|255] "unitless:" Vector__XXX
 SG_ PDM_OutputStatus18 m2 : 39|8@0+ (1,0) [0|255] "unitless:" Vector__XXX
 SG_ PDM_OutputStatus19 m2 : 47|8@0+ (1,0) [0|255] "unitless:" Vector__XXX
 SG_ PDM_OutputStatus20 m2 : 55|8@0+ (1,0) [0|255] "unitless:" Vector__XXX
 SG_ PDM_OutputStatus21 m2 : 63|8@0+ (1,0) [0|255] "unitless:" Vector__XXX
 SG_ PDM_OutputStatus22 m3 : 15|8@0+ (1,0) [0|255] "unitless:" Vector__XXX
 SG_ PDM_OutputStatus23 m3 : 23|8@0+ (1,0) [0|255] "unitless:" Vector__XXX
 SG_ PDM_OutputStatus24 m3 : 31|8@0+ (1,0) [0|255] "unitless:" Vector__XXX
 SG_ PDM_OutputStatus25 m3 : 39|8@0+ (1,0) [0|255] "unitless:" Vector__XXX
 SG_ PDM_OutputStatus26 m3 : 47|8@0+ (1,0) [0|255] "unitless:" Vector__XXX
 SG_ PDM_OutputStatus27 m3 : 55|8@0+ (1,0) [0|255] "unitless:" Vector__XXX
 SG_ PDM_OutputStatus28 m3 : 63|8@0+ (1,0) [0|255] "unitless:" Vector__XXX
 SG_ PDM_OutputStatus29 m4 : 15|8@0+ (1,0) [0|255] "unitless:" Vector__XXX
 SG_ PDM_OutputStatus30 m4 : 23|8@0+ (1,0) [0|255] "unitless:" Vector__XXX
 SG_ PDM_OutputStatus31 m4 : 31|8@0+ (1,0) [0|255] "unitless:" Vector__XXX
 SG_ PDM_OutputStatus32 m4 : 39|8@0+ (1,0) [0|255] "unitless:" Vector__XXX

BO_ 1285 InputVoltages: 8 PDM32
 SG_ PDM_Index_0x505 M : 7|8@0+ (1,0) [0|255] "unitless:" Vector__XXX
 SG_ PDM_InputVoltage1 m0 : 15|8@0+ (0.2,0) [0|51] "voltage:V" Vector__XXX
 SG_ PDM_InputVoltage2 m0 : 23|8@0+ (0.2,0) [0|51] "voltage:V" Vector__XXX
 SG_ PDM_InputVoltage3 m0 : 31|8@0+ (0.2,0) [0|51] "voltage:V" Vector__XXX
 SG_ PDM_InputVoltage4 m0 : 39|8@0+ (0.2,0) [0|51] "voltage:V" Vector__XXX
 SG_ PDM_InputVoltage5 m0 : 47|8@0+ (0.2,0) [0|51] "voltage:V" Vector__XXX
 SG_ PDM_InputVoltage6 m0 : 55|8@0+ (0.2,0) [0|51] "voltage:V" Vector__XXX
 SG_ PDM_InputVoltage7 m0 : 63|8@0+ (0.2,0) [0|51] "voltage:V" Vector__XXX
 SG_ PDM_InputVoltage8 m1 : 15|8@0+ (0.2,0) [0|51] "voltage:V" Vector__XXX
 SG_ PDM_InputVoltage9 m1 : 23|8@0+ (0.2,0) [0|51] "voltage:V" Vector__XXX
 SG_ PDM_InputVoltage10 m1 : 31|8@0+ (0.2,0) [0|51] "voltage:V" Vector__XXX
 SG_ PDM_InputVoltage11 m1 : 39|8@0+ (0.2,0) [0|51] "voltage:V" Vector__XXX
 SG_ PDM_InputVoltage12 m1 : 47|8@0+ (0.2,0) [0|51] "voltage:V" Vector__XXX
 SG_ PDM_InputVoltage13 m1 : 55|8@0+ (0.2,0) [0|51] "voltage:V" Vector__XXX
 SG_ PDM_InputVoltage14 m1 : 63|8@0+ (0.2,0) [0|51] "voltage:V" Vector__XXX
 SG_ PDM_InputVoltage15 m2 : 15|8@0+ (0.2,0) [0|51] "voltage:V" Vector__XXX
 SG_ PDM_InputVoltage16 m2 : 23|8@0+ (0.2,0) [0|51] "voltage:V" Vector__XXX
 SG_ PDM_InputVoltage17 m2 : 31|8@0+ (0.2,0) [0|51] "voltage:V" Vector__XXX
 SG_ PDM_InputVoltage18 m2 : 39|8@0+ (0.2,0) [0|51] "voltage:V" Vector__XXX
 SG_ PDM_InputVoltage19 m2 : 47|8@0+ (0.2,0) [0|51] "voltage:V" Vector__XXX
 SG_ PDM_InputVoltage20 m2 : 55|8@0+ (0.2,0) [0|51] "voltage:V" Vector__XXX
 SG_ PDM_InputVoltage21 m2 : 63|8@0+ (0.2,0) [0|51] "voltage:V" Vector__XXX
 SG_ PDM_InputVoltage22 m3 : 15|8@0+ (0.2,0) [0|51] "voltage:V" Vector__XXX
 SG_ PDM_InputVoltage23 m3 : 23|8@0+ (0.2,0) [0|51] "voltage:V" Vector__XXX

BA_DEF_ BO_  "DBC_Author" STRING ;
BA_DEF_ BO_  "GenMsgSendType" STRING ;
BA_DEF_ BO_  "GenMsgCycleTime" INT 1 10000;
BA_DEF_ BO_  "GenMsgILSupport" ENUM  "No","Yes";
BA_DEF_ BU_  "ILUsed" ENUM  "No","Yes";
BA_DEF_  "VersionNumber" INT 0 10000;
BA_DEF_  "VersionDay" INT 1 31;
BA_DEF_  "VersionMonth" INT 1 12;
BA_DEF_  "VersionYear" INT 2016 3000;
BA_DEF_  "BusType" STRING ;
BA_DEF_ BO_  "DBC_Author_Contact" STRING ;
BA_DEF_DEF_  "DBC_Author" "AEM_Performance_Electronics";
BA_DEF_DEF_  "GenMsgSendType" "Cyclic";
BA_DEF_DEF_  "GenMsgCycleTime" 20;
BA_DEF_DEF_  "GenMsgILSupport" "Yes";
BA_DEF_DEF_  "ILUsed" "Yes";
BA_DEF_DEF_  "VersionNumber" 0;
BA_DEF_DEF_  "VersionDay" 12;
BA_DEF_DEF_  "VersionMonth" 1;
BA_DEF_DEF_  "VersionYear" 2017;
BA_DEF_DEF_  "BusType" "Can";
BA_DEF_DEF_  "DBC_Author_Contact" "CANbusInfo@AEMelectronics.com";
BA_ "BusType" "CAN";
VAL_ 1280 PDM_InputState1 1 "Active" 0 "Inactive" ;
VAL_ 1280 PDM_InputState2 1 "Active" 0 "Inactive" ;
VAL_ 1280 PDM_InputState3 1 "Active" 0 "Inactive" ;
VAL_ 1280 PDM_InputState4 1 "Active" 0 "Inactive" ;
VAL_ 1280 PDM_InputState5 1 "Active" 0 "Inactive" ;
VAL_ 1280 PDM_InputState6 1 "Active" 0 "Inactive" ;
VAL_ 1280 PDM_InputState7 1 "Active" 0 "Inactive" ;
VAL_ 1280 PDM_InputState8 1 "Active" 0 "Inactive" ;
VAL_ 1280 PDM_InputState9 1 "Active" 0 "Inactive" ;
VAL_ 1280 PDM_InputState10 1 "Active" 0 "Inactive" ;
VAL_ 1280 PDM_InputState11 1 "Active" 0 "Inactive" ;
VAL_ 1280 PDM_InputState12 1 "Active" 0 "Inactive" ;
VAL_ 1280 PDM_InputState13 1 "Active" 0 "Inactive" ;
VAL_ 1280 PDM_InputState14 1 "Active" 0 "Inactive" ;
VAL_ 1280 PDM_InputState15 1 "Active" 0 "Inactive" ;
VAL_ 1280 PDM_InputState16 1 "Active" 0 "Inactive" ;
VAL_ 1280 PDM_InputState17 1 "Active" 0 "Inactive" ;
VAL_ 1280 PDM_InputState18 1 "Active" 0 "Inactive" ;
VAL_ 1280 PDM_InputState19 1 "Active" 0 "Inactive" ;
VAL_ 1280 PDM_InputState20 1 "Active" 0 "Inactive" ;
VAL_ 1280 PDM_InputState21 1 "Active" 0 "Inactive" ;
VAL_ 1280 PDM_InputState22 1 "Active" 0 "Inactive" ;
VAL_ 1280 PDM_InputState23 1 "Active" 0 "Inactive" ;
VAL_ 1280 PDM_GlobalErrorFlag 1 "Error" 0 "OK" ;
VAL_ 1284 PDM_OutputStatus1 4 "Output Fault Error" 2 "Output Over-Current Error" 1 "Output ON" 0 "Output OFF" ;
VAL_ 1284 PDM_OutputStatus2 4 "Output Fault Error" 2 "Output Over-Current Error" 1 "Output ON" 0 "Output OFF" ;
VAL_ 1284 PDM_OutputStatus3 4 "Output Fault Error" 2 "Output Over-Current Error" 1 "Output ON" 0 "Output OFF" ;
VAL_ 1284 PDM_OutputStatus4 4 "Output Fault Error" 2 "Output Over-Current Error" 1 "Output ON" 0 "Output OFF" ;
VAL_ 1284 PDM_OutputStatus5 4 "Output Fault Error" 2 "Output Over-Current Error" 1 "Output ON" 0 "Output OFF" ;
VAL_ 1284 PDM_OutputStatus6 4 "Output Fault Error" 2 "Output Over-Current Error" 1 "Output ON" 0 "Output OFF" ;
VAL_ 1284 PDM_OutputStatus7 4 "Output Fault Error" 2 "Output Over-Current Error" 1 "Output ON" 0 "Output OFF" ;
VAL_ 1284 PDM_OutputStatus8 4 "Output Fault Error" 2 "Output Over-Current Error" 1 "Output ON" 0 "Output OFF" ;
VAL_ 1284 PDM_OutputStatus9 4 "Output Fault Error" 2 "Output Over-Current Error" 1 "Output ON" 0 "Output OFF" ;
VAL_ 1284 PDM_OutputStatus10 4 "Output Fault Error" 2 "Output Over-Current Error" 1 "Output ON" 0 "Output OFF" ;
VAL_ 1284 PDM_OutputStatus11 4 "Output Fault Error" 2 "Output Over-Current Error" 1 "Output ON" 0 "Output OFF" ;
VAL_ 1284 PDM_OutputStatus12 4 "Output Fault Error" 2 "Output Over-Current Error" 1 "Output ON" 0 "Output OFF" ;
VAL_ 1284 PDM_OutputStatus13 4 "Output Fault Error" 2 "Output Over-Current Error" 1 "Output ON" 0 "Output OFF" ;
VAL_ 1284 PDM_OutputStatus14 4 "Output Fault Error" 2 "Output Over-Current Error" 1 "Output ON" 0 "Output OFF" ;
VAL_ 1284 PDM_OutputStatus15 4 "Output Fault Error" 2 "Output Over-Current Error" 1 "Output ON" 0 "Output OFF" ;
VAL_ 1284 PDM_OutputStatus16 4 "Output Fault Error" 2 "Output Over-Current Error" 1 "Output ON" 0 "Output OFF" ;
VAL_ 1284 PDM_OutputStatus17 4 "Output Fault Error" 2 "Output Over-Current Error" 1 "Output ON" 0 "Output OFF" ;
VAL_ 1284 PDM_OutputStatus18 4 "Output Fault Error" 2 "Output Over-Current Error" 1 "Output ON" 0 "Output OFF" ;
VAL_ 1284 PDM_OutputStatus19 4 "Output Fault Error" 2 "Output Over-Current Error" 1 "Output ON" 0 "Output OFF" ;
VAL_ 1284 PDM_OutputStatus20 4 "Output Fault Error" 2 "Output Over-Current Error" 1 "Output ON" 0 "Output OFF" ;
VAL_ 1284 PDM_OutputStatus21 4 "Output Fault Error" 2 "Output Over-Current Error" 1 "Output ON" 0 "Output OFF" ;
VAL_ 1284 PDM_OutputStatus22 4 "Output Fault Error" 2 "Output Over-Current Error" 1 "Output ON" 0 "Output OFF" ;
VAL_ 1284 PDM_OutputStatus23 4 "Output Fault Error" 2 "Output Over-Current Error" 1 "Output ON" 0 "Output OFF" ;
VAL_ 1284 PDM_OutputStatus24 4 "Output Fault Error" 2 "Output Over-Current Error" 1 "Output ON" 0 "Output OFF" ;
VAL_ 1284 PDM_OutputStatus25 4 "Output Fault Error" 2 "Output Over-Current Error" 1 "Output ON" 0 "Output OFF" ;
VAL_ 1284 PDM_OutputStatus26 4 "Output Fault Error" 2 "Output Over-Current Error" 1 "Output ON" 0 "Output OFF" ;
VAL_ 1284 PDM_OutputStatus27 4 "Output Fault Error" 2 "Output Over-Current Error" 1 "Output ON" 0 "Output OFF" ;
VAL_ 1284 PDM_OutputStatus28 4 "Output Fault Error" 2 "Output Over-Current Error" 1 "Output ON" 0 "Output OFF" ;
VAL_ 1284 PDM_OutputStatus29 4 "Output Fault Error" 2 "Output Over-Current Error" 1 "Output ON" 0 "Output OFF" ;
VAL_ 1284 PDM_OutputStatus30 4 "Output Fault Error" 2 "Output Over-Current Error" 1 "Output ON" 0 "Output OFF" ;
VAL_ 1284 PDM_OutputStatus31 4 "Output Fault Error" 2 "Output Over-Current Error" 1 "Output ON" 0 "Output OFF" ;
VAL_ 1284 PDM_OutputStatus32 4 "Output Fault Error" 2 "Output Over-Current Error" 1 "Output ON" 0 "Output OFF" ;
